## config/boards/shields/manuform/Kconfig.defconfig
```kconfig
if SHIELD_MANUFORM_LEFT
    config ZMK_KEYBOARD_NAME
        default "Manuform"
    config ZMK_SPLIT_ROLE_CENTRAL
        default y
endif
```

## config/boards/shields/manuform/Kconfig.shield
```kconfig
config SHIELD_MANUFORM_LEFT
    def_bool $(shields_list_contains, manuform_left)

config SHIELD_MANUFORM_RIGHT
    def_bool $(shields_list_contains, manuform_right)
```
